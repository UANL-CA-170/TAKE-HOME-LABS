// This program is free software: you can redistribute it and/or modify
// it under the terms of the GNU General Public License as published by
// the Free Software Foundation, either version 3 of the License, or
// (at your option) any later version.

#include <Wire.h>
#include <Adafruit_GFX.h>
#include <Adafruit_SSD1306.h>
#include <SoftwareSerial.h>

// Control-Observador-RC-RC

// ******************************************************** //
//                                                          //
// Control por asignación de polos para circuito RC-RC      //
//                                                          //
// Noviembre 13 del 2022, MAPG, EAG                         //
//                                                          //
// ******************************************************** //


// ******************************************************** //
//---------- Polos de control --------//                    
// ******************************************************** //
#define a1r -1                         
#define a1i -1.7320508                 
#define a2r -1                         
#define a2i 1.7320508                 
// ******************************************************** //

// ******************************************************** //
//---------- Polos de observador   --------//               
// ******************************************************** //
#define b1r -10                        
#define b1i 0                        
#define b2r -10                        
#define b2i 0                        
// ******************************************************** //

// ******************************************************** //
//----------  Valores de R1, C1, R2, C2 en planta  -------- //
// ******************************************************** //
#define R1 1000000                                        
#define R2 1000000                                        
#define C1 0.000001                                       
#define C2 0.000001                                       
// ******************************************************** //

// ******************************************************** //
//----------  Muestreo  --------//                          
// ******************************************************** //
unsigned long TS = 100;      // Control cada 50 ms
float Tseg = 0.1;          // Muestreo en Tseg segundos
// ******************************************************** //

// ******************************************************** //
//----------  Pines y escalas  --------//                    
// ******************************************************** //
#define pR 0                
#define pX1 1               
#define pX2 2                     
#define pU 5       

#define pLEDON 11             
#define pLEDOFF 9              
#define pSW2 2              
#define pSW3 3       
#define pHMI 8     
#define pCtrl 4  
#define pObs 7   

#define mX 0.004882813      
#define bX 0                
#define mU 51               
#define bU 0                

#define SCREEN_WIDTH 128
#define SCREEN_HEIGHT 64
#define OLED_RESET    -1
Adafruit_SSD1306 display(SCREEN_WIDTH, SCREEN_HEIGHT, &Wire, OLED_RESET);

// ******************************************************** //
//----------  Declaraciones  --------//                      //
// ******************************************************** //
// // 'flama_UANLc', 128x64px
const unsigned char flama_UANLc [] PROGMEM = {
  0x00, 0x00, 0x00, 0x00, 0x00, 0x00, 0x00, 0x00, 0x00, 0x00, 0x00, 0x00, 0x00, 0x00, 0x00, 0x00, 
  0x00, 0x7f, 0x07, 0xf0, 0x00, 0x01, 0xfe, 0x00, 0x00, 0x7e, 0x0f, 0xe0, 0x00, 0xfe, 0x00, 0x00, 
  0x00, 0x7f, 0x07, 0xf0, 0x00, 0x01, 0xfe, 0x00, 0x00, 0x7e, 0x0f, 0xe0, 0x00, 0xfe, 0x00, 0x00, 
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  0x00, 0x00, 0x00, 0x00, 0x00, 0x00, 0x00, 0x3f, 0xff, 0xfc, 0x00, 0x00, 0x00, 0x00, 0x00, 0x00
};


 // 'vlf', 128x45px
const unsigned char VLF1 [] PROGMEM = {
  0x00, 0x00, 0x00, 0x00, 0x00, 0x00, 0x00, 0x00, 0x00, 0x00, 0x00, 0x00, 0x00, 0x00, 0x00, 0x00, 
  0x00, 0x00, 0x00, 0x00, 0x00, 0x00, 0x00, 0x00, 0x00, 0x00, 0x00, 0x00, 0x00, 0x00, 0x00, 0x00, 
  0x00, 0x00, 0x00, 0x00, 0x00, 0x00, 0x00, 0x00, 0x00, 0x00, 0x00, 0x00, 0x00, 0x00, 0x00, 0x00, 
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  0x00, 0x00, 0x00, 0x00, 0x00, 0x00, 0x00, 0x00, 0x00, 0x00, 0x00, 0x00, 0x00, 0x00, 0x00, 0x00
};


// 'og_fime3', 128x64px
const unsigned char og3 [] PROGMEM = {
  0x00, 0x00, 0x00, 0x00, 0x00, 0x00, 0x00, 0x00, 0x00, 0x00, 0x00, 0x00, 0x00, 0x00, 0x00, 0x00, 
  0x00, 0x00, 0x00, 0x00, 0x00, 0x00, 0x00, 0x00, 0x00, 0x00, 0x00, 0x00, 0x00, 0x00, 0x00, 0x00, 
  0x00, 0x00, 0x00, 0x00, 0x00, 0x00, 0x00, 0x00, 0x00, 0x00, 0x00, 0x00, 0x00, 0x00, 0x00, 0x00, 
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  0x00, 0x00, 0x00, 0x00, 0x00, 0x00, 0x00, 0x00, 0x00, 0x00, 0x00, 0x00, 0x00, 0x00, 0x00, 0x00
};


const unsigned char og [] PROGMEM = {
  // 'og, 63x64px
  0x00, 0x00, 0x00, 0x00, 0x00, 0x00, 0x00, 0x00, 0x00, 0x00, 0x00, 0x00, 0x00, 0x00, 0x00, 0x00, 
  0x00, 0x00, 0x00, 0x00, 0x00, 0x00, 0x00, 0x00, 0x00, 0x00, 0x00, 0x00, 0x00, 0x00, 0x00, 0x00, 
  0x00, 0x00, 0x00, 0x00, 0x00, 0x00, 0x00, 0x00, 0x00, 0xc0, 0x00, 0x00, 0x00, 0x00, 0x06, 0x00, 
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  0x00, 0x00, 0x00, 0x00, 0x00, 0x00, 0x00, 0x00, 0x00, 0x00, 0x00, 0x00, 0x00, 0x00, 0x00, 0x00
};


// ******************************************************** //
//---------- Variables globales --------//                    
// ******************************************************** //
float Kp=0, K1=0, K2=0;  // Ganancias control
float H1=0, H2=0;        // Ganancias observador
float TIME = 0;
unsigned long TS_code=0; // Tiempo de ciclo control
unsigned long TIC=0;     

float R=0, Y=0, X1=0, X2=0, U=0;
int Ui=0;

// Observador
float XeR1=0, XeR2=0;
float Am11=0, Am12=0, Am21=0, Am22=0;
float Bm1=0, Bm2=0;

bool Habilitado=0;        // Memoria escalón
int columna = 10;
bool primeraPasada = true;


// ---------------- Timer2 ---------------- //
volatile int tickCounter = 0;
volatile bool flagControl = false;
volatile bool flagPantalla = false;

void setupTimer2() {
  cli(); // Deshabilita interrupciones globales
  TCCR2A = 0;
  TCCR2B = 0;
  TCNT2 = 0;
  OCR2A = 155;           // 16MHz / 1024 / 10ms
  TCCR2A |= (1 << WGM21); // Modo CTC
  TCCR2B |= (1 << CS22) | (1 << CS21) | (1 << CS20); // Prescaler 1024
  TIMSK2 |= (1 << OCIE2A); // Interrupción COMPA
  sei(); // Habilita interrupciones globales
}

ISR(TIMER2_COMPA_vect) {
  tickCounter++;
  if (tickCounter % 10 == 0) {
    proc_entradas();
    observador();
    control();
    proc_salidas();
  }
  if(tickCounter % 10 == 0) flagPantalla = true;  
  if(tickCounter >= 100) tickCounter = 0;
}

// ******************************************************** //
//---------- Rutina de inicio --------//                   
// ******************************************************** //
void setup() {
  Serial.begin(9600);
  pantalla_init();

  pinMode(pSW2, INPUT);
  pinMode(pSW3, INPUT);
  pinMode(pHMI, INPUT);
  pinMode(pCtrl, INPUT);
  pinMode(pObs, INPUT);
  pinMode(pLEDON, OUTPUT);
  pinMode(pLEDOFF, OUTPUT);

  //-- Determina ganancias --// 
  float p11 = R1*C1, p12 = R1*C2, p21 = R2*C1, p22 = R2*C2;
  float sum_a = -(a1r + a2r);
  float prod_a = a1r*a2r - a1i*a2i;
  float sum_b = -(b1r + b2r);
  float prod_b = b1r*b2r - b1i*b2i;

  Am11 = -1/p11 - 1/p21;
  Am12 = 1/p21;
  Am21 = 1/p22;
  Am22 = -1/p22;
  Bm1 = 1/p11;
  Bm2 = 0;

  K1 = p11*(sum_a - 1/p11 - 1/p21 - 1/p22);
  K2 = p12*p22*(prod_a - 1/(p11*p22) - 1/(p21*p21) - K1/(p21*p22) + 1/(p21*p22));
  Kp = K1 + K2 + 1;

  H2 = sum_b - 1/p11 - 1/p22 - 1/p22;
  H1 = p22*(prod_b - ((1/p11 + 1/p21)*(1/p22 + H2))) + 1/p21;

  TIC = millis();
  setupTimer2(); // Inicializa Timer2
}

// ******************************************************** //
//---------- Rutina principal --------//                  
// ******************************************************** //
void loop() {
  if(flagPantalla){
    flagPantalla = false;
    coms(&R, &Y, &U, "arduino");
    pantalla(R, Y, U);      
    TS_code = millis() - TIC; // Guarda tiempo de ciclo
    TIC = millis();
    TIME = float(TS_code);
  }
}

// ******************************************************** //
//---------- Control y observador --------//                          
// ******************************************************** //
void control(){
  if (digitalRead(pObs) == HIGH) {
    U = Kp*R - K1*XeR1 - K2*XeR2;
  }
  else {
  U = Kp*R - K1*X1 - K2*X2;
  }
  if(U >= 5.0) U = 5.0;
  else if(U < 0) U = 0;
}


//void observador_euler(){
//  float f1 = Am11*XeR1 + Am12*XeR2 + Bm1*U + H1*(Y-XeR2);
//  float f2 = Am21*XeR1 + Am22*XeR2 + Bm2*U + H2*(Y-XeR2);
//  XeR1 += Tseg*f1;
//  XeR2 += Tseg*f2;
//}

void observador() {
  // Define the derivatives as lambda functions
  auto f1 = [&](float x1, float x2) { return Am11*x1 + Am12*x2 + Bm1*U + H1*(Y-x2); };
  auto f2 = [&](float x1, float x2) { return Am21*x1 + Am22*x2 + Bm2*U + H2*(Y-x2); };

  // --- RK4 for XeR ---
  float k1_1 = Tseg * f1(XeR1, XeR2);
  float k1_2 = Tseg * f2(XeR1, XeR2);

  float k2_1 = Tseg * f1(XeR1 + 0.5*k1_1, XeR2 + 0.5*k1_2);
  float k2_2 = Tseg * f2(XeR1 + 0.5*k1_1, XeR2 + 0.5*k1_2);

  float k3_1 = Tseg * f1(XeR1 + 0.5*k2_1, XeR2 + 0.5*k2_2);
  float k3_2 = Tseg * f2(XeR1 + 0.5*k2_1, XeR2 + 0.5*k2_2);

  float k4_1 = Tseg * f1(XeR1 + k3_1, XeR2 + k3_2);
  float k4_2 = Tseg * f2(XeR1 + k3_1, XeR2 + k3_2);

  // Update states
  XeR1 += (k1_1 + 2*k2_1 + 2*k3_1 + k4_1) / 6.0;
  XeR2 += (k1_2 + 2*k2_2 + 2*k3_2 + k4_2) / 6.0;
}

// ******************************************************** //
//---------- IO y control de tiempo --------//                          
// ******************************************************** //
void proc_entradas(){
  X1 = analogRead(pX1)*mX+bX;
  X2 = analogRead(pX2)*mX+bX;
  R = Habilitado*(analogRead(pR)*mX+bX);
  Y = X2;
}

void proc_salidas(){
  Ui = int(U*mU+bU);
  analogWrite(pU, Ui);
  botonesyleds();
}

void botonesyleds(){
  
  if(digitalRead(pSW2) == 1) Habilitado = 1;
  else if(digitalRead(pSW3) == 1) Habilitado = 0;

  if(Habilitado == 1) digitalWrite(pLEDON,HIGH);
  else digitalWrite(pLEDON, LOW);

  if(Habilitado == 0) digitalWrite(pLEDOFF,HIGH);
  else digitalWrite(pLEDOFF, LOW);
}

void pantalla_init() {
  if(!display.begin(SSD1306_SWITCHCAPVCC, 0x3C)) { // Dirección I2C común 0x3C
    Serial.println(F("No se detecta pantalla OLED SSD1306"));
    for(;;); // Se queda aquí si falla
  }

  display.clearDisplay();
  display.setTextSize(1);
  display.setTextColor(SSD1306_WHITE);
  display.setCursor(0, 0);
  display.println(F("Sistema RC-RC"));
  display.display();
  delay(1000); 
  testdrawbitmap9() ;
  testdrawbitmap();    // Draw the required image 
  testdrawbitmap1();    // Draw the required image 
  testdrawbitmap2();    // Draw the required image 
}

void pantalla(float R, float Y, float U) {
  if (digitalRead(pHMI) == HIGH) {
  display.clearDisplay();
  display.setTextSize(2);
  display.setTextColor(SSD1306_WHITE);

  display.setCursor(0, 0);
  display.print(F("R="));
  display.print(R, 4); // 4 decimales

  display.setCursor(0, 22);
  display.print(F("Y="));
  display.print(Y, 4);

  display.setCursor(0, 44);
  display.print(F("U="));
  display.print(U, 4);

  display.display();
  primeraPasada = true; // Reinicia para la próxima vez que vaya al scope
  }
  else {
     if (primeraPasada) {
      display.clearDisplay(); // Borra la pantalla solo la primera vez
      primeraPasada = false;
    }
    
    display.drawLine(10, 8, 10, 48, SSD1306_WHITE);  // Eje Y
    display.drawLine(10, 48, 127, 48, SSD1306_WHITE); // Eje X

    int sensor = analogRead(pX2); // Leer el valor del ADC (12 bits)
    int sensorR = Habilitado*analogRead(pR); // Leer el valor del ADC (12 bits)
  
    // Dibuja la línea anterior en negro (borrar la anterior)
    display.drawLine(columna, 0, columna, 54, SSD1306_BLACK); // 0, columna, SCREEN_HEIGHT, SSD1306_BLACK);

    // Escala el valor de sensor para ajustarlo al alto de la pantalla (0-64 píxeles)
    int altura = map(sensor, 0, 1023, 0, 48); //SCREEN_HEIGHT);  // 1023
    int alturaR = map(sensorR, 0, 1023, 0, 48); //SCREEN_HEIGHT);  // 1023
    
    // Dibuja el nuevo valor del sensor como un píxel en la pantalla
    display.drawPixel(columna, 48 - altura, SSD1306_WHITE); // SCREEN_HEIGHT - altura, SSD1306_WHITE);
    display.drawPixel(columna, 48 - alturaR, SSD1306_WHITE); // SCREEN_HEIGHT - altura, SSD1306_WHITE);

    // Mueve la columna
    columna++;
    if (columna >= SCREEN_WIDTH) columna = 10; // Si llega al final, reinicia a la columna 0

    // Dibuja la nueva línea en blanco
    display.drawLine(columna, 8, columna, 48, SSD1306_WHITE); // 0, columna, SCREEN_HEIGHT, SSD1306_WHITE);

  display.setTextSize(1);
  display.setTextColor(SSD1306_WHITE);
  display.setCursor(10,52);
  display.println("Setpoint + observer");
  display.display();
}    
}


// ******************************************************** //
//---------- Comunicación serial con PC monitor  --------//
void coms(float* Rp, float* Yp, float* Up, String modo){
  if(modo == "python"){
    byte* byteData1 = (byte*)(Rp);
    byte* byteData2 = (byte*)(Yp);
    byte* byteData3 = (byte*)(Up);
    byte buf[12] = {byteData1[0], byteData1[1], byteData1[2], byteData1[3],
                     byteData2[0], byteData2[1], byteData2[2], byteData2[3],
                     byteData3[0], byteData3[1], byteData3[2], byteData3[3]};
    Serial.write(buf, 12);
  }
  else if(modo == "arduino"){
    Serial.print("u(t):");  
    Serial.print(*Up);         
    Serial.print(",");    
    Serial.print("y_d(t):");  
    Serial.print(*Rp);         
    Serial.print(",");       
    Serial.print("y(t):");    
    Serial.println(*Yp);      
  }
}

void testdrawbitmap9(void) {
  display.clearDisplay();
  display.drawBitmap(
    (display.width()  - 128 ) / 2,
    (display.height() - 64 ) / 2,
    flama_UANLc, 128, 64, 1);
  display.display();
  delay(3000);
}

void testdrawbitmap(void) {
  display.clearDisplay();

  display.drawBitmap(
    (display.width()  - 128 ) / 2,
    (display.height() - 46 ) / 2,
    VLF1, 128, 46, 1);
  display.display();
  delay(3000);
}

void testdrawbitmap1(void) {
  display.clearDisplay();

  display.drawBitmap(
    (display.width()  - 128 ) / 2,
    (display.height() - 64 ) / 2,
    og3, 128, 64, 1);
  display.display();
  delay(3000);
}

void testdrawbitmap2(void) {
  display.clearDisplay();

  display.drawBitmap(
    (display.width()  - 64 ) / 2,
    (display.height() - 64 ) / 2,
    og, 64, 64, 1);
  display.display();
  delay(3000);
}
