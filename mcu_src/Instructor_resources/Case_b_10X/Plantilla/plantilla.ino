// This program is free software: you can redistribute it and/or modify
// it under the terms of the GNU General Public License as published by
// the Free Software Foundation, either version 3 of the License, or
// (at your option) any later version.

/*
 * ============================================================
 *  Control-Observador-RC-RC
 *  ------------------------------------------------------------
 *  Control por asignación de polos para un sistema RC-RC
 *  con observador de estado e interfaz OLED.
 *
 *  Autor: MAPG, EAG
 *  Fecha: Octuber 13, 2025
 *
 *  Descripción:
 *  Implementación de un sistema de control digital y observador
 *  de estado para una planta RC-RC, con visualización en OLED
 *  y selección de modos de operación mediante interruptores.
 *
 *  Licencia:
 *  Este programa es software libre: puede redistribuirlo y/o 
 *  modificarlo bajo los términos de la GNU General Public License 
 *  publicada por la Free Software Foundation, ya sea la versión 3 
 *  de la Licencia, o (a su elección) cualquier versión posterior.
 * ============================================================
 */

// ******************************************************** //
//---------- INICIO DEL PROGRAMA --------//                    
// ******************************************************** //

// ******************************************************** //
//---------- Librerias a usar --------//                    
// ******************************************************** //
#include <Wire.h>
#include <Adafruit_GFX.h>
#include <Adafruit_SSD1306.h>
#include <SoftwareSerial.h>

// ******************************************************** //
//---------- Polos de control --------//                    
// ******************************************************** //
#define a1r -1                         
#define a1i -1.7320508                 
#define a2r -1                         
#define a2i 1.7320508                 
// En el caso de control integral se ocupa polo extra
#define a3r -1                                              //
#define a3i 0                                               //
// ******************************************************** //

// ******************************************************** //
//---------- Polos de observador   --------//               
// ******************************************************** //
#define b1r -10                        
#define b1i 0                        
#define b2r -10                        
#define b2i 0                        
// ******************************************************** //

// ******************************************************** //
//----------  Valores de R1, C1, R2, C2 en planta  -------- //
// ******************************************************** //
#define R1 1000000                                        
#define R2 1000000                                        
#define C1 0.000001                                       
#define C2 0.000001                                       
// ******************************************************** //

// ******************************************************** //
//----------  Muestreo  --------//                          
// ******************************************************** //
unsigned long TS = 100;      // Control cada 50 ms
float Tseg = 0.1;          // Muestreo en Tseg segundos
// ******************************************************** //

// ******************************************************** //
//----------  Pines   --------//                    
// ******************************************************** //
// Interacción con planta
#define pR 0                
#define pX1 1               
#define pX2 2                     
#define pU 5       

// Interacción con usuario
#define pLEDON 11             
#define pLEDOFF 9              
#define pSW2 2              
#define pSW3 3       
#define pHMI 8     
#define pCtrl 4  
#define pObs 7   

// ******************************************************** //
//----------  Escalamientos  --------//                    
// ******************************************************** //
#define mX 0.004882813      
#define bX 0                
#define mU 51               
#define bU 0                

// ******************************************************** //
//----------  Configuración OLED  --------//                    
// ******************************************************** //
#define SCREEN_WIDTH 128
#define SCREEN_HEIGHT 64
#define OLED_RESET    -1
Adafruit_SSD1306 display(SCREEN_WIDTH, SCREEN_HEIGHT, &Wire, OLED_RESET);

//String mensaje = "Modo: ";
String mod1 = "Setpoint-CCoor";
String mod12 = "Setpoint-CCoor-Obs";
String mod2 = "Setpoint-CInt";
String mod22 = "Setpoint-CInt-Obs";

// ******************************************************** //
//----------  Declaraciones  --------//                      //
// ******************************************************** //
// // 'flama_UANLc', 128x64px
const unsigned char flama_UANLc [] PROGMEM = {
  0x00, 0x00, 0x00, 0x00, 0x00, 0x00, 0x00, 0x00, 0x00, 0x00, 0x00, 0x00, 0x00, 0x00, 0x00, 0x00, 
  0x00, 0x7f, 0x07, 0xf0, 0x00, 0x01, 0xfe, 0x00, 0x00, 0x7e, 0x0f, 0xe0, 0x00, 0xfe, 0x00, 0x00, 
  0x00, 0x7f, 0x07, 0xf0, 0x00, 0x01, 0xfe, 0x00, 0x00, 0x7e, 0x0f, 0xe0, 0x00, 0xfe, 0x00, 0x00, 
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  0x00, 0x00, 0x00, 0x00, 0x00, 0x00, 0x00, 0x3f, 0xff, 0xfc, 0x00, 0x00, 0x00, 0x00, 0x00, 0x00
};


//  // 'vlf', 128x45px
// const unsigned char VLF1 [] PROGMEM = {
//   0x00, 0x00, 0x00, 0x00, 0x00, 0x00, 0x00, 0x00, 0x00, 0x00, 0x00, 0x00, 0x00, 0x00, 0x00, 0x00, 
//   0x00, 0x00, 0x00, 0x00, 0x00, 0x00, 0x00, 0x00, 0x00, 0x00, 0x00, 0x00, 0x00, 0x00, 0x00, 0x00, 
//   0x00, 0x00, 0x00, 0x00, 0x00, 0x00, 0x00, 0x00, 0x00, 0x00, 0x00, 0x00, 0x00, 0x00, 0x00, 0x00, 
//   0x00, 0x00, 0x00, 0x00, 0x00, 0x00, 0x00, 0x00, 0x00, 0x00, 0x00, 0x00, 0x00, 0x00, 0x00, 0x00, 
//   0x00, 0x00, 0x00, 0x00, 0x00, 0x00, 0x00, 0x00, 0x00, 0x00, 0x00, 0x00, 0x00, 0x00, 0x03, 0xf0, 
//   0x00, 0x00, 0x00, 0x00, 0x00, 0x00, 0x00, 0x00, 0x00, 0x00, 0x00, 0x00, 0x00, 0x00, 0x1f, 0xf0, 
//   0x00, 0x00, 0x00, 0x00, 0x00, 0x00, 0x00, 0x00, 0x00, 0x00, 0x00, 0x00, 0x00, 0x04, 0x1f, 0xc0, 
//   0x00, 0x00, 0x00, 0x00, 0x00, 0x00, 0x00, 0x00, 0x00, 0x00, 0x00, 0x00, 0x00, 0x1c, 0x3f, 0x80, 
//   0x00, 0x00, 0x00, 0x00, 0x00, 0x00, 0x00, 0x00, 0x00, 0x00, 0x00, 0x00, 0x00, 0x3c, 0x3c, 0x00, 
//   0x00, 0x00, 0x00, 0x00, 0x00, 0x00, 0x00, 0x00, 0x00, 0x00, 0x00, 0x00, 0x60, 0x3e, 0x38, 0x00, 
//   0x00, 0x00, 0x00, 0x00, 0x00, 0x00, 0x00, 0x00, 0x00, 0x00, 0x07, 0x80, 0x70, 0x7c, 0x38, 0x00, 
//   0x00, 0x00, 0x00, 0x00, 0x00, 0x00, 0x00, 0x00, 0x00, 0x00, 0xff, 0x08, 0x70, 0xfc, 0x38, 0x00, 
//   0x00, 0x00, 0x00, 0x00, 0x00, 0x00, 0x00, 0x00, 0x00, 0x03, 0xfc, 0x1c, 0x79, 0xfc, 0x39, 0xe0, 
//   0x00, 0x00, 0x00, 0x00, 0x00, 0x00, 0x00, 0x00, 0x00, 0x03, 0xf0, 0x18, 0x79, 0xdc, 0x3f, 0xe0, 
//   0x00, 0x00, 0x00, 0x00, 0x00, 0x00, 0x00, 0x00, 0x00, 0x01, 0x80, 0x1c, 0x7f, 0x9c, 0x3f, 0x80, 
//   0x00, 0x00, 0x00, 0x00, 0x00, 0x00, 0x00, 0x00, 0xf0, 0x03, 0x80, 0x18, 0xff, 0x9c, 0x7f, 0x00, 
//   0x00, 0x00, 0x00, 0x00, 0x00, 0x00, 0x00, 0x00, 0xf0, 0x03, 0x80, 0x18, 0xff, 0x1c, 0x78, 0x00, 
//   0x00, 0x00, 0x00, 0x00, 0x00, 0x00, 0x00, 0x01, 0xf8, 0x03, 0x80, 0x38, 0xe6, 0x1c, 0x70, 0x00, 
//   0x00, 0x00, 0x00, 0x00, 0x00, 0x00, 0x18, 0x01, 0xf8, 0x03, 0x80, 0x38, 0xe0, 0x1c, 0x70, 0x00, 
//   0x00, 0x00, 0x00, 0x00, 0x03, 0xe0, 0x18, 0x03, 0xd8, 0x03, 0xfc, 0x38, 0xe0, 0x1c, 0x71, 0xe0, 
//   0x00, 0x00, 0x00, 0x00, 0x0f, 0xe0, 0x38, 0x03, 0x9c, 0x03, 0xfc, 0x38, 0xe0, 0x3c, 0x7f, 0xe0, 
//   0x00, 0x00, 0x00, 0x00, 0xbf, 0xc0, 0x38, 0x07, 0x8c, 0x03, 0xf8, 0x38, 0xe0, 0x3c, 0x7f, 0xe0, 
//   0x00, 0x01, 0x80, 0x01, 0x9c, 0x00, 0x38, 0x07, 0x8c, 0x03, 0xe0, 0x38, 0xc0, 0x38, 0x7f, 0x80, 
//   0x00, 0x03, 0x89, 0x83, 0x98, 0x00, 0x38, 0x07, 0xbe, 0x03, 0x80, 0x38, 0xc0, 0x18, 0x7c, 0x00, 
//   0x02, 0x03, 0x89, 0x83, 0x38, 0x00, 0x38, 0x07, 0xfe, 0x03, 0x80, 0x38, 0xc0, 0x18, 0x70, 0x00, 
//   0x03, 0x03, 0x8d, 0xc3, 0x3c, 0x00, 0x38, 0x0f, 0x1e, 0x03, 0x80, 0x18, 0xc0, 0x00, 0x00, 0x00, 
//   0x07, 0x07, 0x1d, 0xc7, 0x3f, 0xc0, 0x38, 0x0f, 0x0e, 0x03, 0x80, 0x10, 0x80, 0x00, 0x00, 0x00, 
//   0x07, 0x07, 0x1d, 0xe7, 0x3f, 0x80, 0x38, 0x06, 0x06, 0x03, 0x00, 0x00, 0x00, 0x00, 0x00, 0x00, 
//   0x03, 0x0f, 0x1c, 0xe7, 0x3c, 0x00, 0x38, 0xc6, 0x04, 0x03, 0x00, 0x00, 0x00, 0x00, 0x00, 0x00, 
//   0x03, 0x8e, 0x1c, 0xff, 0x38, 0x00, 0x3f, 0xc4, 0x00, 0x03, 0x00, 0x00, 0x00, 0x00, 0x00, 0x00, 
//   0x03, 0x8e, 0x18, 0xff, 0x38, 0x00, 0x3f, 0xe0, 0x00, 0x00, 0x00, 0x00, 0x00, 0x00, 0x00, 0x00, 
//   0x03, 0x8e, 0x18, 0x7e, 0x3b, 0xe0, 0x3f, 0x80, 0x00, 0x00, 0x00, 0x00, 0x00, 0x00, 0x00, 0x00, 
//   0x03, 0x9c, 0x18, 0x7e, 0x3f, 0xe0, 0x38, 0x00, 0x00, 0x00, 0x00, 0x00, 0x00, 0x00, 0x00, 0x00, 
//   0x03, 0xdc, 0x18, 0x7e, 0x3f, 0xc0, 0x00, 0x00, 0x00, 0x00, 0x00, 0x00, 0x00, 0x00, 0x00, 0x00, 
//   0x01, 0xfc, 0x18, 0x3c, 0x18, 0x00, 0x00, 0x00, 0x00, 0x00, 0x00, 0x00, 0x00, 0x00, 0x00, 0x00, 
//   0x01, 0xfc, 0x18, 0x38, 0x00, 0x00, 0x00, 0x00, 0x00, 0x00, 0x00, 0x00, 0x00, 0x00, 0x00, 0x00, 
//   0x01, 0xf8, 0x18, 0x00, 0x00, 0x00, 0x00, 0x00, 0x00, 0x00, 0x00, 0x00, 0x00, 0x00, 0x00, 0x00, 
//   0x01, 0xf8, 0x00, 0x00, 0x00, 0x00, 0x00, 0x00, 0x00, 0x00, 0x00, 0x00, 0x00, 0x00, 0x00, 0x00, 
//   0x00, 0xf8, 0x00, 0x00, 0x00, 0x00, 0x00, 0x00, 0x00, 0x00, 0x00, 0x00, 0x00, 0x00, 0x00, 0x00, 
//   0x00, 0xf0, 0x00, 0x00, 0x00, 0x00, 0x00, 0x00, 0x00, 0x00, 0x00, 0x00, 0x00, 0x00, 0x00, 0x00, 
//   0x00, 0xf0, 0x00, 0x00, 0x00, 0x00, 0x00, 0x00, 0x00, 0x00, 0x00, 0x00, 0x00, 0x00, 0x00, 0x00, 
//   0x00, 0x20, 0x00, 0x00, 0x00, 0x00, 0x00, 0x00, 0x00, 0x00, 0x00, 0x00, 0x00, 0x00, 0x00, 0x00, 
//   0x00, 0x00, 0x00, 0x00, 0x00, 0x00, 0x00, 0x00, 0x00, 0x00, 0x00, 0x00, 0x00, 0x00, 0x00, 0x00, 
//   0x00, 0x00, 0x00, 0x00, 0x00, 0x00, 0x00, 0x00, 0x00, 0x00, 0x00, 0x00, 0x00, 0x00, 0x00, 0x00, 
//   0x00, 0x00, 0x00, 0x00, 0x00, 0x00, 0x00, 0x00, 0x00, 0x00, 0x00, 0x00, 0x00, 0x00, 0x00, 0x00
// };


const unsigned char og [] PROGMEM = {
  // 'og, 63x64px
  0x00, 0x00, 0x00, 0x00, 0x00, 0x00, 0x00, 0x00, 0x00, 0x00, 0x00, 0x00, 0x00, 0x00, 0x00, 0x00, 
  0x00, 0x00, 0x00, 0x00, 0x00, 0x00, 0x00, 0x00, 0x00, 0x00, 0x00, 0x00, 0x00, 0x00, 0x00, 0x00, 
  0x00, 0x00, 0x00, 0x00, 0x00, 0x00, 0x00, 0x00, 0x00, 0xc0, 0x00, 0x00, 0x00, 0x00, 0x06, 0x00, 
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  0x00, 0x00, 0x00, 0x00, 0x00, 0x00, 0x00, 0x00, 0x00, 0x00, 0x00, 0x00, 0x00, 0x00, 0x00, 0x00
};

// ******************************************************** //
//---------- Variables globales --------//                    
// ******************************************************** //
float Kpc=0, K1c=0, K2c=0;  // Ganancias control
float Kpi=0, K1i=0, K2i=0;  // Ganancias control
float H1=0, H2=0;        // Ganancias observador
float X0N = 0; 
float TIME = 0;
unsigned long TS_code=0; // Tiempo de ciclo control
unsigned long TIC=0;     

float R=0, Y=0, X1=0, X2=0, U=0;
int Ui=0;

// Observador
float XeR1=0, XeR2=0, X0 = 0;
float Am11=0, Am12=0, Am21=0, Am22=0;
float Bm1=0, Bm2=0;

bool Habilitado=0;        // Memoria escalón
int columna = 10;
bool primeraPasada = true;


// ---------------- Timer2 ---------------- //
volatile int tickCounter = 0;
volatile bool flagControl = false;
volatile bool flagPantalla = false;

void setupTimer2() {
  cli(); // Deshabilita interrupciones globales
  TCCR2A = 0;
  TCCR2B = 0;
  TCNT2 = 0;
  OCR2A = 155;           // 16MHz / 1024 / 10ms
  TCCR2A |= (1 << WGM21); // Modo CTC
  TCCR2B |= (1 << CS22) | (1 << CS21) | (1 << CS20); // Prescaler 1024
  TIMSK2 |= (1 << OCIE2A); // Interrupción COMPA
  sei(); // Habilita interrupciones globales
}

ISR(TIMER2_COMPA_vect) {
  tickCounter++;
  if (tickCounter % 10 == 0) {
    proc_entradas();
    observador();
    control();
    proc_salidas();
  }
  if(tickCounter % 10 == 0) flagPantalla = true;  
  if(tickCounter >= 100) tickCounter = 0;
}

// ******************************************************** //
//---------- Rutina de inicio --------//                   
// ******************************************************** //
void setup() {
  Serial.begin(9600);
  pantalla_init();

  pinMode(pSW2, INPUT);
  pinMode(pSW3, INPUT);
  pinMode(pHMI, INPUT);
  pinMode(pCtrl, INPUT);
  pinMode(pObs, INPUT);
  pinMode(pLEDON, OUTPUT);
  pinMode(pLEDOFF, OUTPUT);

  //-- Determina ganancias --// 
  float p11 = R1*C1, p12 = R1*C2, p21 = R2*C1, p22 = R2*C2;
  Am11 = -1/p11 - 1/p21;
  Am12 = 1/p21;
  Am21 = 1/p22;
  Am22 = -1/p22;
  Bm1 = 1/p11;
  Bm2 = 0;

  float sum_ai = -(a1r  + a2r + a3r);
  float prod_ai = -( a1r*a2r - a1i*a2i )*a3r;
  Kpi = p11*p22*prod_ai;
  K1i = p11*(sum_ai - 1/(p11) - 1/(p21) - 1/(p22) );
  K2i = p11*(p22*(a1r*a3r + a2r*a3r + a1r*a2r)+1/(p21));

  float sum_ac = -(a1r + a2r);
  float prod_ac = a1r*a2r - a1i*a2i;  
  K1c = p11*(sum_ac - 1/p11 - 1/p21 - 1/p22);
  K2c = p12*p22*(prod_ac - 1/(p11*p22) - 1/(p21*p21) - K1c/(p21*p22) + 1/(p21*p22));
  Kpc = K1c + K2c + 1;

  float sum_b = -(b1r + b2r);
  float prod_b = b1r*b2r - b1i*b2i;
  H2 = sum_b - 1/p11 - 1/p22 - 1/p22;
  H1 = p22*(prod_b - ((1/p11 + 1/p21)*(1/p22 + H2))) + 1/p21;

  TIC = millis();
  setupTimer2(); // Inicializa Timer2
  }

// ******************************************************** //
//---------- Rutina principal --------//                  
// ******************************************************** //
void loop() {
  if(flagPantalla){
    flagPantalla = false;
    coms(&R, &Y, &U, "arduino");
    pantalla(R, Y, U);      
    TS_code = millis() - TIC; // Guarda tiempo de ciclo
    TIC = millis();
    TIME = float(TS_code);
  }
}

// ******************************************************** //
//---------- Control y observador --------//                          
// ******************************************************** //
void control(){
  if (digitalRead(pCtrl) == HIGH) {
  if (digitalRead(pObs) == HIGH) {
    U = Kpi*X0 - K1i*XeR1 - K2i*XeR2;
  }
  else {
    U = Kpi*X0 - K1i*X1 - K2i*X2;
  }
  // Integracion 
  float f3 = R - Y;
  X0N  = X0 + Tseg*f3;
  X0  = Habilitado*X0N;
  }
  else {
  if (digitalRead(pObs) == HIGH) {
    U = Kpc*R - K1c*XeR1 - K2c*XeR2;
    }
  else {
    U = Kpc*R - K1c*X1 - K2c*X2;
  }    
  }
  
  if(U >= 5.0) U = 5.0;
  else if(U < 0) U = 0;  

}


//void observador_euler(){
//  float f1 = Am11*XeR1 + Am12*XeR2 + Bm1*U + H1*(Y-XeR2);
//  float f2 = Am21*XeR1 + Am22*XeR2 + Bm2*U + H2*(Y-XeR2);
//  XeR1 += Tseg*f1;
//  XeR2 += Tseg*f2;
//}

void observador() {
  // Define the derivatives as lambda functions
  auto f1 = [&](float x1, float x2) { return Am11*x1 + Am12*x2 + Bm1*U + H1*(Y-x2); };
  auto f2 = [&](float x1, float x2) { return Am21*x1 + Am22*x2 + Bm2*U + H2*(Y-x2); };

  // --- RK4 for XeR ---
  float k1_1 = Tseg * f1(XeR1, XeR2);
  float k1_2 = Tseg * f2(XeR1, XeR2);

  float k2_1 = Tseg * f1(XeR1 + 0.5*k1_1, XeR2 + 0.5*k1_2);
  float k2_2 = Tseg * f2(XeR1 + 0.5*k1_1, XeR2 + 0.5*k1_2);

  float k3_1 = Tseg * f1(XeR1 + 0.5*k2_1, XeR2 + 0.5*k2_2);
  float k3_2 = Tseg * f2(XeR1 + 0.5*k2_1, XeR2 + 0.5*k2_2);

  float k4_1 = Tseg * f1(XeR1 + k3_1, XeR2 + k3_2);
  float k4_2 = Tseg * f2(XeR1 + k3_1, XeR2 + k3_2);

  // Update states
  XeR1 += (k1_1 + 2*k2_1 + 2*k3_1 + k4_1) / 6.0;
  XeR2 += (k1_2 + 2*k2_2 + 2*k3_2 + k4_2) / 6.0;
}

// ******************************************************** //
//---------- IO y control de tiempo --------//                          
// ******************************************************** //
void proc_entradas(){
  X1 = analogRead(pX1)*mX+bX;
  X2 = analogRead(pX2)*mX+bX;
  R = Habilitado*(analogRead(pR)*mX+bX);
  Y = X2;
}

void proc_salidas(){
  Ui = int(U*mU+bU);
  analogWrite(pU, Ui);
  botonesyleds();
}

void botonesyleds(){
  
  if(digitalRead(pSW2) == 1) Habilitado = 1;
  else if(digitalRead(pSW3) == 1) Habilitado = 0;

  if(Habilitado == 1) digitalWrite(pLEDON,HIGH);
  else digitalWrite(pLEDON, LOW);

  if(Habilitado == 0) digitalWrite(pLEDOFF,HIGH);
  else digitalWrite(pLEDOFF, LOW);
}

void pantalla_init() {
  if(!display.begin(SSD1306_SWITCHCAPVCC, 0x3C)) { // Dirección I2C común 0x3C
    Serial.println(F("No se detecta pantalla OLED SSD1306"));
    for(;;); // Se queda aquí si falla
  }

  display.clearDisplay();
  display.setTextSize(1);
  display.setTextColor(SSD1306_WHITE);
  display.setCursor(20, 30);
  display.println(F("Sistema RC-RC"));
  display.display();
  delay(1000); 
  testdrawbitmap9() ;
//  testdrawbitmap();    // Draw the required image 
  display.clearDisplay();
  display.setTextSize(2);
  display.setTextColor(SSD1306_WHITE);
  display.setCursor(15, 5);
  display.println(F("U.A.N.L."));
  display.setCursor(15, 25);
  display.println(F("F.I.M.E."));
  display.setTextSize(1.5);
  display.setCursor(0, 45);
  display.println(F("GPL V 3.0   Oct 2025"));
  display.setTextSize(1);
  display.setCursor(0, 55);
  display.println(F("plantilla 2.0"));
  display.display();
  delay(3000); 
  testdrawbitmap2();    // Draw the required image 
}

void pantalla(float R, float Y, float U) {
  if (digitalRead(pHMI) == HIGH) {
  display.clearDisplay();
  display.setTextSize(2);
  display.setTextColor(SSD1306_WHITE);

  display.setCursor(0, 0);
  display.print(F("R="));
  display.print(R, 4); // 4 decimales

  display.setCursor(0, 18);
  display.print(F("Y="));
  display.print(Y, 4);

  display.setCursor(0, 36);
  display.print(F("U="));
  display.print(U, 4);

  // display.display();
  display.setTextSize(1);
  display.setTextColor(SSD1306_WHITE);
  display.fillRect(0, 56, 127, 8, BLACK);
  display.setCursor(10,56);
//  display.print(mensaje);
//      display.setCursor(40,52);
    if (digitalRead(pCtrl) == HIGH) {
       if (digitalRead(pObs) == HIGH) {
         display.print(mod22);
         }
       else {
         display.print(mod2);
         }
       }
      else {
       if (digitalRead(pObs) == HIGH) {
         display.print(mod12);  
         }
      else {
         display.print(mod1);
         }
       }
  display.display();  
  primeraPasada = true; // Reinicia para la próxima vez que vaya al scope
  }
  else {
     if (primeraPasada) {
      display.clearDisplay(); // Borra la pantalla solo la primera vez
      primeraPasada = false;
    }
    display.drawLine(10, 0, 10, 48, SSD1306_WHITE);  // Eje Y
    display.drawLine(10, 48, 127, 48, SSD1306_WHITE); // Eje X
    display.drawLine(8, 24, 12, 24, SSD1306_WHITE); // Eje X
    display.drawLine(8, 0, 12, 0, SSD1306_WHITE); // Eje X

    int sensor = analogRead(pX2); // Leer el valor del ADC (12 bits)
    int sensorR = Habilitado*analogRead(pR); // Leer el valor del ADC (12 bits)
  
    // Dibuja la línea anterior en negro (borrar la anterior)
    display.drawLine(columna, 0, columna, 54, SSD1306_BLACK); // 0, columna, SCREEN_HEIGHT, SSD1306_BLACK);

    // Escala el valor de sensor para ajustarlo al alto de la pantalla (0-64 píxeles)
    int altura = map(sensor, 0, 1023, 0, 48); //SCREEN_HEIGHT);  // 1023
    int alturaR = map(sensorR, 0, 1023, 0, 48); //SCREEN_HEIGHT);  // 1023
    
    // Dibuja el nuevo valor del sensor como un píxel en la pantalla
    display.drawPixel(columna, 48 - altura, SSD1306_WHITE); // SCREEN_HEIGHT - altura, SSD1306_WHITE);
    display.drawPixel(columna, 48 - alturaR, SSD1306_WHITE); // SCREEN_HEIGHT - altura, SSD1306_WHITE);

    // Mueve la columna
    columna++;
    if (columna >= SCREEN_WIDTH) columna = 10; // Si llega al final, reinicia a la columna 0

    // Dibuja la nueva línea en blanco
    display.drawLine(columna, 0, columna, 48, SSD1306_WHITE); // 0, columna, SCREEN_HEIGHT, SSD1306_WHITE);
 
    display.setTextSize(1);
    display.fillRect(0, 54, 127, 8, BLACK);
    display.setTextColor(SSD1306_WHITE);
    display.setCursor(10,54);
//    display.print(mensaje);
//    display.setCursor(40,52);
    if (digitalRead(pCtrl) == HIGH) {
       if (digitalRead(pObs) == HIGH) {
         display.print(mod22);
         }
       else {
         display.print(mod2);
         }
       }
      else {
       if (digitalRead(pObs) == HIGH) {
         display.print(mod12);  
         }
      else {
         display.print(mod1);
         }
       }
    display.display(); 
}    
}


// ******************************************************** //
//---------- Comunicación serial con PC monitor  --------//
void coms(float* Rp, float* Yp, float* Up, String modo){
  if(modo == "python"){
    byte* byteData1 = (byte*)(Rp);
    byte* byteData2 = (byte*)(Yp);
    byte* byteData3 = (byte*)(Up);
    byte buf[12] = {byteData1[0], byteData1[1], byteData1[2], byteData1[3],
                     byteData2[0], byteData2[1], byteData2[2], byteData2[3],
                     byteData3[0], byteData3[1], byteData3[2], byteData3[3]};
    Serial.write(buf, 12);
  }
  else if(modo == "arduino"){
    Serial.print("u(t):");  
    Serial.print(*Up);         
    Serial.print(",");    
    Serial.print("y_d(t):");  
    Serial.print(*Rp);         
    Serial.print(",");       
    Serial.print("y(t):");    
    Serial.println(*Yp);      
  }
}

void testdrawbitmap9(void) {
  display.clearDisplay();
  display.drawBitmap(
    (display.width()  - 128 ) / 2,
    (display.height() - 64 ) / 2,
    flama_UANLc, 128, 64, 1);
  display.display();
  delay(3000);
}

// void testdrawbitmap(void) {
//   display.clearDisplay();

//   display.drawBitmap(
//     (display.width()  - 128 ) / 2,
//     (display.height() - 46 ) / 2,
//     VLF1, 128, 46, 1);
//   display.display();
//   delay(3000);
// }

void testdrawbitmap2(void) {
  display.clearDisplay();

  display.drawBitmap(
    (display.width()  - 64 ) / 2,
    (display.height() - 64 ) / 2,
    og, 64, 64, 1);
  display.display();
  delay(3000);
}
